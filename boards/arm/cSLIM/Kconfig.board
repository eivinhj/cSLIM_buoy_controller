## boards/arm/cSLIM/Kconfig.board
```kconfig
# nRF9160 DK NRF9160 board configuration

# Copyright (c) 2018-2020 Nordic Semiconductor ASA
# SPDX-License-Identifier: Apache-2.0

if SOC_NRF9160_SICA

config BOARD_cSLIM
	bool "cSLIM"

config BOARD_cSLIMNS
	bool "cSLIM non-secure"

endif # SOC_NRF9160_SICA
```

## build/spm/Kconfig/Kconfig.shield
```kconfig
osource "C:/Users/eivin/ncs/v1.5.1/nrf/boards/shields/*/Kconfig.shield"
osource "C:/Users/eivin/ncs/v1.5.1/zephyr/boards/shields/*/Kconfig.shield"
osource "C:/Users/eivin/ncs/v1.5.1/zephyr/boards/shields/*/Kconfig.shield"
```

## build/spm/Kconfig/Kconfig.shield.defconfig
```kconfig
osource "C:/Users/eivin/ncs/v1.5.1/nrf/boards/shields/*/Kconfig.defconfig"
osource "C:/Users/eivin/ncs/v1.5.1/zephyr/boards/shields/*/Kconfig.defconfig"
osource "C:/Users/eivin/ncs/v1.5.1/zephyr/boards/shields/*/Kconfig.defconfig"
```
